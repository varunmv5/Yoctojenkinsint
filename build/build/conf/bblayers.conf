## build/build/conf/bblayers.conf
```bitbake
# POKY_BBLAYERS_CONF_VERSION is increased each time build/conf/bblayers.conf
# changes incompatibly
POKY_BBLAYERS_CONF_VERSION = "2"

BBPATH = "${TOPDIR}"
BBFILES ?= ""

BBLAYERS ?= " \
  /home/varun/Yoctojenkinsint/poky-morty-16.0.1/meta \
  /home/varun/Yoctojenkinsint/poky-morty-16.0.1/meta-poky \
  /home/varun/Yoctojenkinsint/poky-morty-16.0.1/meta-yocto-bsp \
  /home/varun/Yoctojenkinsint/poky-morty-16.0.1/meta-qt5 \
  /home/varun/Yoctojenkinsint/poky-morty-16.0.1/meta-lab2-qemux86-64 \
  "
```
